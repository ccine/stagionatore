#include "display.h"

// salame inverted binary, 315x117px
const unsigned char epd_bitmap_salame2Small[] PROGMEM = {
  0x00, 0x00, 0x00, 0x00, 0x00, 0x00, 0x00, 0x00, 0x00, 0x00, 0x00, 0x00, 0x00, 0x00, 0x00, 0x00,
  0x00, 0x00, 0x00, 0x00, 0x00, 0x00, 0x00, 0x00, 0x00, 0x00, 0x00, 0x00, 0x00, 0x00, 0x00, 0x00,
  0x00, 0x00, 0x00, 0x00, 0x00, 0x00, 0x00, 0x00, 0x00, 0x00, 0x00, 0x00, 0x00, 0x00, 0x00, 0x00,
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  0x00, 0x00, 0x00, 0x00, 0x00, 0x00, 0x00, 0x00
};

CustomDisplay::CustomDisplay()
  : screen(0) {
}

void CustomDisplay::initDisplay(Stagionatore *stagionatore) {
  uint16_t ID = tft.readID();
  tft.begin(ID);
  // Configura la touchscreen
  pinMode(XM, OUTPUT);
  pinMode(YP, OUTPUT);
  tft.setRotation(1);

  cooling_btn.initButton(&tft, 10, 65, "FRIGO", COOLING_RELAY_PIN);
  heating_btn.initButton(&tft, 165, 65, "RISCALDA", HEATING_RELAY_PIN);
  fan_btn.initButton(&tft, 10, 125, "VENTOLA", FAN_RELAY_PIN);
  dehum_btn.initButton(&tft, 165, 125, "ESTRATTORE", DEHUMIDIFIER_RELAY_PIN);
  hum_btn.initButton(&tft, 10, 185, "UMIDIFICA", HUMIDIFIER_RELAY_PIN);
  home_screen_btn.initButton(&tft, 240, 210, 150, 50, BLACK, CYAN, BLACK, "<- HOME", 2);
  auto_screen_btn.initButton(&tft, 80, 80, 150, 60, BLACK, WHITE, BLACK, "AUTO", 2);
  program_screen_btn.initButton(&tft, 240, 80, 150, 60, BLACK, WHITE, BLACK, "PROGRAMMA", 2);
  test_screen_btn.initButton(&tft, 265, 140, 100, 40, BLACK, WHITE, BLACK, "TEST", 2);
  sub5T_btn.initButton(&tft, 35, 80, 60, 60, BLACK, WHITE, BLACK, "-5", 2);
  sub1T_btn.initButton(&tft, 100, 80, 60, 60, BLACK, WHITE, BLACK, "-1", 2);
  add1T_btn.initButton(&tft, 220, 80, 60, 60, BLACK, WHITE, BLACK, "+1", 2);
  add5T_btn.initButton(&tft, 285, 80, 60, 60, BLACK, WHITE, BLACK, "+5", 2);
  sub10H_btn.initButton(&tft, 35, 150, 60, 60, BLACK, WHITE, BLACK, "-10", 2);
  sub5H_btn.initButton(&tft, 100, 150, 60, 60, BLACK, WHITE, BLACK, "-5", 2);
  add5H_btn.initButton(&tft, 220, 150, 60, 60, BLACK, WHITE, BLACK, "+5", 2);
  add10H_btn.initButton(&tft, 285, 150, 60, 60, BLACK, WHITE, BLACK, "+10", 2);
  start_btn.initButton(&tft, 80, 210, 150, 50, BLACK, GREEN, BLACK, "START", 2);
  stop_btn.initButton(&tft, 155, 210, 150, 50, BLACK, RED, BLACK, "STOP", 2);

  tft.fillScreen(GREY);

  this->stagionatore = stagionatore;
  update();
}

void CustomDisplay::update() {
  // Update sensor values on the screen
  chamberSensorData current = stagionatore->getSensorData();
  showValues(current.temperatureUp, current.humidityUp, current.temperatureDown, current.humidityDown);

  if (stagionatore->getStatus().isRunning) {
    if (screen == 4) {
      // Is running and screen is correct, update screen
      updateRunning();
    } else {
      // Is running and screen not correct, change screen
      screen == 4;
      loadedScreen = false;
    }
  } else {
    // Not running and screen not correct, change screen
    if (screen == 4) {
      screen = 0;
      loadedScreen = false;
    }
  }

  if (!loadedScreen) {
    tft.fillRect(0, 40, 320, 210, GREY);
    switch (screen) {
      case 0:
        loadHomeScreen();
        break;
      case 1:
        loadAutoScreen();
        break;
      case 2:
        loadProgramScreen();
        break;
      case 3:
        loadTestScreen();
        break;
      case 4:
        loadRunningScreen();
        break;
      default:
        loadHomeScreen();
        break;
    }
    loadedScreen = true;
  }
  handleUserInput();
}

void CustomDisplay::updateRunning() {
  chamberStatus status = stagionatore->getStatus();

  // Step number
  if (status.currentStep != lastStep) {
    tft.fillRect(180, 85, 130, 30, GREY);
    tft.setTextSize(2);
    tft.setTextColor(BLACK);
    tft.setCursor(190, 90);
    tft.print(String(status.currentStep) + "/" + String(status.nSteps));
    lastStep = status.currentStep;
  }
  // Elapsed time
  if (status.elapsedTime != lastTime) {
    tft.fillRect(180, 145, 130, 30, GREY);
    tft.setTextSize(2);
    tft.setTextColor(BLACK);
    tft.setCursor(190, 150);
    tft.print(String(status.elapsedTime) + "/" + String(status.duration));
    lastTime = status.elapsedTime;
  }
  // Temperature or humidity changed
  if (selectedTemp != status.targetTemperature || selectedHum != status.targetHumidity) {
    tft.fillRect(50, 65, 65, 105, GREY);
    tft.setTextSize(3);
    tft.setTextColor(BLACK);
    tft.setCursor(55, 70);
    tft.print(status.targetTemperature);
    tft.print("C");
    tft.setCursor(55, 140);
    tft.print(status.targetHumidity);
    tft.print("%");
    selectedTemp = status.targetTemperature;
    selectedHum = status.targetHumidity;
  }

  bool relayChanged = lastCooling != status.cooling || lastHeating != status.heating || lastFan != status.fan || lastDehumidifier != status.dehumidifier || lastHumidifier != status.humidifier;
  if (!relayChanged) return;
  int size = 30, halfSize = size / 2;
  tft.fillRect(10, 70, size, size, GREY);
  tft.fillRect(120, 70, size, size, GREY);
  tft.fillRect(10, 140, size, size, GREY);
  tft.fillRect(120, 140, size, size, GREY);
  if (status.cooling) {
    // Disegna freccia in basso azzurra
    int x = 10, y = 70;
    tft.fillTriangle(x, y, x + halfSize, y + size, x + size, y, CYAN);
  }
  if (status.heating) {
    // Disegna freccia in alto rossa
    int x = 120, y = 70;
    tft.fillTriangle(x, y + size, x + halfSize, y, x + size, y + size, RED);
  }
  if (status.dehumidifier) {
    int x = 10, y = 140;
    tft.fillTriangle(x, y, x + halfSize, y + size, x + size, y, BLACK);
  }
  if (status.humidifier) {
    int x = 120, y = 140;
    tft.fillTriangle(x, y + size, x + halfSize, y, x + size, y + size, BLACK);
  }

  lastCooling = status.cooling;
  lastHeating = status.heating;
  lastFan = status.fan;
  lastDehumidifier = status.dehumidifier;
  lastHumidifier = status.humidifier;
}

float CustomDisplay::getSelectedTemperature() {
  return selectedTemp;
}
int CustomDisplay::getSelectedHumidity() {
  return selectedHum;
}
bool CustomDisplay::isRunning() {
  return running;
}
bool CustomDisplay::isProgramMode() {
  return programMode;
}
void CustomDisplay::stop() {
  running = false;
}

void CustomDisplay::showValues(float temperatureUp, int humidityUp, float temperatureDown, int humidityDown) {
  if (lastTUp != temperatureUp || lastHUp != humidityUp || lastTDown != temperatureDown || lastHDown != humidityDown) {
    //tft.fillRect(30, 0, 80, 30, GREY);   // Pulisci valore temperatura
    //tft.fillRect(200, 0, 40, 30, GREY);  // Pulisci valore umidità
    tft.fillRect(0, 0, 320, 40, GREY);

    // Mostra le misure attuali dei sensori sopra
    tft.setTextSize(2);
    tft.setTextColor(BLACK);
    tft.setCursor(10, 5);
    tft.print("Sopra T:");
    tft.print(temperatureUp, 1);
    tft.print(" C - H:");
    tft.print(humidityUp);
    tft.print(" %");
    // Mostra le misure attuali dei sensori sotto
    tft.setCursor(10, 25);
    tft.print("Sotto T:");
    tft.print(temperatureDown, 1);
    tft.print(" C - H:");
    tft.print(humidityDown);
    tft.print(" %");

    lastTUp = temperatureUp;
    lastHUp = humidityUp;
    lastTDown = temperatureDown;
    lastHDown = humidityDown;
  }
}


void CustomDisplay::loadHomeScreen() {
  testModeClick = 0;
  auto_screen_btn.drawButton();
  test_screen_btn.drawButton();
  program_screen_btn.drawButton();
  tft.drawBitmap(2, 123, epd_bitmap_salame2Small, 315, 117, BLACK);
}

void CustomDisplay::loadAutoScreen() {
  home_screen_btn.drawButton();
  add1T_btn.drawButton();
  add5T_btn.drawButton();
  sub1T_btn.drawButton();
  sub5T_btn.drawButton();
  add10H_btn.drawButton();
  add5H_btn.drawButton();
  sub5H_btn.drawButton();
  sub10H_btn.drawButton();
  start_btn.drawButton();

  // Mostra le misure da impostare
  tft.setTextSize(3);
  tft.setTextColor(BLACK);
  tft.setCursor(135, 70);
  tft.print(selectedTemp);
  tft.print("C");
  tft.setCursor(135, 140);
  tft.print(selectedHum);
  tft.print("%");
}
void CustomDisplay::loadProgramScreen() {
  home_screen_btn.drawButton();
  start_btn.drawButton();
}
void CustomDisplay::loadTestScreen() {
  cooling_btn.drawButton();
  heating_btn.drawButton();
  fan_btn.drawButton();
  dehum_btn.drawButton();
  hum_btn.drawButton();
  home_screen_btn.drawButton();
}

void CustomDisplay::loadRunningScreen() {
  stop_btn.drawButton();
  // Mostra le misure impostate
  tft.setTextSize(3);
  tft.setTextColor(BLACK);
  tft.setCursor(55, 70);
  tft.print(selectedTemp);
  tft.print("C");
  tft.setCursor(55, 140);
  tft.print(selectedHum);
  tft.print("%");

  // Mostra step e time
  tft.setTextSize(2);
  tft.setTextColor(BLACK);
  tft.setCursor(170, 70);
  tft.print("Step:");
  tft.setCursor(170, 130);
  tft.print("Time (min.):");

  // Inizializza icone
  lastCooling = false;
  lastHeating = false;
  lastFan = false;
  lastDehumidifier = false;
  lastHumidifier = false;
  lastStep = -1;
  lastTime = -1;
}

void CustomDisplay::handleUserInput() {
  bool down = Touch_getXY();
  switch (screen) {
    case 0:
      handleHomeScreen(down);
      break;
    case 1:
      handleAutoScreen(down);
      break;
    case 2:
      handleProgramScreen(down);
      break;
    case 4:
      handleRunningScreen(down);
      break;
    case 3:
      handleTestScreen(down);
      break;
  }
}

void CustomDisplay::handleHomeScreen(bool down) {
  auto_screen_btn.press(down && auto_screen_btn.contains(pixel_x, pixel_y));
  test_screen_btn.press(down && test_screen_btn.contains(pixel_x, pixel_y));
  program_screen_btn.press(down && program_screen_btn.contains(pixel_x, pixel_y));
  if (auto_screen_btn.justReleased())
    auto_screen_btn.drawButton();
  if (auto_screen_btn.justPressed()) {
    auto_screen_btn.drawButton(true);
    screen = 1;
    loadedScreen = false;
  }
  if (program_screen_btn.justReleased())
    program_screen_btn.drawButton();
  if (program_screen_btn.justPressed()) {
    program_screen_btn.drawButton(true);
    screen = 2;
    loadedScreen = false;
  }
  if (test_screen_btn.justReleased())
    test_screen_btn.drawButton();
  if (test_screen_btn.justPressed()) {
    test_screen_btn.drawButton(true);
    testModeClick++;
    if (testModeClick >= 3) {
      screen = 3;
      loadedScreen = false;
    }
  }
}

void CustomDisplay::handleAutoScreen(bool down) {
  home_screen_btn.press(down && home_screen_btn.contains(pixel_x, pixel_y));
  add1T_btn.press(down && add1T_btn.contains(pixel_x, pixel_y));
  sub1T_btn.press(down && sub1T_btn.contains(pixel_x, pixel_y));
  add5T_btn.press(down && add5T_btn.contains(pixel_x, pixel_y));
  sub5T_btn.press(down && sub5T_btn.contains(pixel_x, pixel_y));
  add5H_btn.press(down && add5H_btn.contains(pixel_x, pixel_y));
  sub5H_btn.press(down && sub5H_btn.contains(pixel_x, pixel_y));
  add10H_btn.press(down && add10H_btn.contains(pixel_x, pixel_y));
  sub10H_btn.press(down && sub10H_btn.contains(pixel_x, pixel_y));
  start_btn.press(down && start_btn.contains(pixel_x, pixel_y));
  if (home_screen_btn.justReleased())
    home_screen_btn.drawButton();
  if (add1T_btn.justReleased())
    add1T_btn.drawButton();
  if (sub1T_btn.justReleased())
    sub1T_btn.drawButton();
  if (add5T_btn.justReleased())
    add5T_btn.drawButton();
  if (sub5T_btn.justReleased())
    sub5T_btn.drawButton();
  if (add5H_btn.justReleased())
    add5H_btn.drawButton();
  if (sub5H_btn.justReleased())
    sub5H_btn.drawButton();
  if (add10H_btn.justReleased())
    add10H_btn.drawButton();
  if (sub10H_btn.justReleased())
    sub10H_btn.drawButton();
  if (start_btn.justReleased())
    start_btn.drawButton();
  if (home_screen_btn.justPressed()) {
    home_screen_btn.drawButton(true);
    screen = 0;
    loadedScreen = false;
  }
  if (add1T_btn.justPressed()) {
    add1T_btn.drawButton(true);
    selectedTemp += 1;
    changedSelectedAuto = true;
  }
  if (sub1T_btn.justPressed()) {
    sub1T_btn.drawButton(true);
    selectedTemp -= 1;
    changedSelectedAuto = true;
  }
  if (add5T_btn.justPressed()) {
    add5T_btn.drawButton(true);
    selectedTemp += 5;
    changedSelectedAuto = true;
  }
  if (sub5T_btn.justPressed()) {
    sub5T_btn.drawButton(true);
    selectedTemp -= 5;
    changedSelectedAuto = true;
  }
  if (add5H_btn.justPressed()) {
    add5H_btn.drawButton(true);
    selectedHum += 5;
    changedSelectedAuto = true;
  }
  if (sub5H_btn.justPressed()) {
    sub5H_btn.drawButton(true);
    selectedHum -= 5;
    changedSelectedAuto = true;
  }
  if (add10H_btn.justPressed()) {
    add10H_btn.drawButton(true);
    selectedHum += 10;
    changedSelectedAuto = true;
  }
  if (sub10H_btn.justPressed()) {
    sub10H_btn.drawButton(true);
    selectedHum -= 10;
    changedSelectedAuto = true;
  }
  if (changedSelectedAuto) {
    if (selectedTemp > 100) selectedTemp = 100;
    if (selectedHum > 100) selectedHum = 100;
    if (selectedTemp < 0) selectedTemp = 0;
    if (selectedHum < 0) selectedHum = 0;
    tft.fillRect(130, 60, 60, 115, GREY);
    // Mostra le misure da impostare
    tft.setTextSize(3);
    tft.setTextColor(BLACK);
    tft.setCursor(135, 70);
    tft.print(selectedTemp);
    tft.print("C");
    tft.setCursor(135, 140);
    tft.print(selectedHum);
    tft.print("%");
    changedSelectedAuto = false;
  }
  if (start_btn.justPressed()) {
    start_btn.drawButton(true);
    stagionatore->startManual(selectedTemp, selectedHum);
    //running = true;
    //programMode = false;
    //screen = 4;
    //loadedScreen = false;
  }
}

void CustomDisplay::handleProgramScreen(bool down) {
  home_screen_btn.press(down && home_screen_btn.contains(pixel_x, pixel_y));
  start_btn.press(down && start_btn.contains(pixel_x, pixel_y));
  if (home_screen_btn.justReleased())
    home_screen_btn.drawButton();
  if (start_btn.justReleased())
    start_btn.drawButton();
  if (home_screen_btn.justPressed()) {
    home_screen_btn.drawButton(true);
    screen = 0;
    loadedScreen = false;
  }
  if (start_btn.justPressed()) {
    start_btn.drawButton(true);
    stagionatore->startProgram();
    //running = true;
    //programMode = true;
    //screen = 4;
    //loadedScreen = false;
  }
}

void CustomDisplay::handleTestScreen(bool down) {
  home_screen_btn.press(down && home_screen_btn.contains(pixel_x, pixel_y));
  if (home_screen_btn.justReleased())
    home_screen_btn.drawButton();
  if (home_screen_btn.justPressed()) {
    home_screen_btn.drawButton(true);
    screen = 0;
    loadedScreen = false;
  }
  cooling_btn.update(down, pixel_x, pixel_y);
  heating_btn.update(down, pixel_x, pixel_y);
  fan_btn.update(down, pixel_x, pixel_y);
  dehum_btn.update(down, pixel_x, pixel_y);
  hum_btn.update(down, pixel_x, pixel_y);
}

void CustomDisplay::handleRunningScreen(bool down) {
  stop_btn.press(down && stop_btn.contains(pixel_x, pixel_y));
  if (stop_btn.justReleased())
    stop_btn.drawButton();
  if (stop_btn.justPressed()) {
    stop_btn.drawButton(true);
    stagionatore->stop();
    //running = false;
    //screen = 0;
    //loadedScreen = false;
  }
}

bool CustomDisplay::Touch_getXY() {
  TSPoint p = ts.getPoint();
  pinMode(YP, OUTPUT);  //restore shared pins
  pinMode(XM, OUTPUT);
  digitalWrite(YP, HIGH);  //because TFT control pins
  digitalWrite(XM, HIGH);
  bool pressed = (p.z > MINPRESSURE && p.z < MAXPRESSURE);
  if (pressed) {
    //pixel_x = map(p.y, 64, 900, 0, 320);               // DISPLAY GRANDE
    //pixel_y = map(p.x, 113, 940, 0, 240);              // DISPLAY GRANDE
    pixel_x = map(p.y, 953, 203, 0, 320);  // DISPLAY PICCOLO
    pixel_y = map(p.x, 943, 175, 0, 240);  // DISPLAY PICCOLO
    /*Serial.print("pressed : ");
    Serial.print(pixel_x);
    Serial.print(" ");
    Serial.println(pixel_y);*/
  }
  return pressed;
}